## boards/esp_mosaico/components/usb_hs_console/Kconfig
```kconfig
menu "USB HS Console Config"

    config USB_HS_CONSOLE_USB_CDC_AUTO_DOWNLOAD
        bool "Enable custom USB CDC auto-download reset"
        depends on TINYUSB_CDC_ENABLED
        depends on !ESP_CONSOLE_USB_CDC
        default n
        help
            Enable USB-Serial/JTAG-compatible DTR/RTS reset handling for the
            custom USB CDC console.

    config USB_HS_CONSOLE_USB_CDC_AUTO_INIT
        bool "Automatically initialize custom USB CDC console"
        depends on TINYUSB_CDC_ENABLED
        depends on !ESP_CONSOLE_USB_CDC
        default n
        help
            Initialize the custom USB CDC console before app_main() starts.

    config USB_HS_CONSOLE_USB_CDC_MIRROR_LOG_TO_UART
        bool "Mirror ESP logs to UART"
        depends on TINYUSB_CDC_ENABLED
        depends on ESP_CONSOLE_UART
        default y
        help
            Mirror ESP_LOG output to the configured console UART while keeping
            the USB CDC console active. Regular printf output remains on USB.
endmenu
```

## boards/esp_mosaico/sdkconfig.defaults.board
```kconfig
CONFIG_ESPTOOLPY_FLASHMODE_QIO=y
CONFIG_ESPTOOLPY_FLASHFREQ_80M=y
CONFIG_ESPTOOLPY_FLASHSIZE_16MB=y

CONFIG_PARTITION_TABLE_CUSTOM=y
CONFIG_PARTITION_TABLE_CUSTOM_FILENAME="partitions_16MB.csv"

CONFIG_SPIRAM=y
CONFIG_SPIRAM_MODE_OCT=y
CONFIG_SPIRAM_SPEED_250M=y
CONFIG_SPIRAM_XIP_FROM_PSRAM=y
CONFIG_SPIRAM_MEMTEST=n

CONFIG_SPIRAM_ALLOW_BSS_SEG_EXTERNAL_MEMORY=y
CONFIG_SPIRAM_ALLOW_NOINIT_SEG_EXTERNAL_MEMORY=y

CONFIG_APP_CLAW_LUA_MODULE_IR=y
CONFIG_APP_CLAW_LUA_DRIVER_ADC=y
CONFIG_APP_CLAW_LUA_MODULE_MAGNETOMETER=y
CONFIG_LUA_MODULE_MAGNETOMETER_CHIP_BMM150=y
CONFIG_BT_ENABLED=y
CONFIG_BT_CONTROLLER_ENABLED=y
CONFIG_BT_BLUEDROID_ENABLED=y
# CONFIG_BT_NIMBLE_ENABLED is not set
CONFIG_BTDM_CTRL_MODE_BR_EDR_ONLY=y
# CONFIG_BTDM_CTRL_MODE_BLE_ONLY is not set
# CONFIG_BTDM_CTRL_MODE_BTDM is not set
# CONFIG_BT_BLE_ENABLED is not set
CONFIG_BT_CLASSIC_ENABLED=y
CONFIG_BT_A2DP_ENABLE=y
CONFIG_BT_A2DP_USE_EXTERNAL_CODEC=y
CONFIG_BT_A2DP_CODEC_AAC_ENABLED=y
CONFIG_BT_A2DP_SEP_NUM_MAX=2
CONFIG_BT_AVRCP_ENABLED=y
CONFIG_BT_AVRCP_CT_COVER_ART_ENABLED=y
# CONFIG_BT_HFP_ENABLE is not set
# CONFIG_BT_PBAC_ENABLED is not set
# CONFIG_ESP_BT_AUDIO_GMF_IO_SUPPORT is not set
CONFIG_AUDIO_DECODER_SBC_SUPPORT=y
CONFIG_AUDIO_DECODER_AAC_SUPPORT=y
CONFIG_AUDIO_DECODER_MP3_SUPPORT=y
CONFIG_MOSAIC_UI_BLUETOOTH_AUDIO=y

# ES8311 audio codec (speaker + microphone).
# CONFIG_APP_CLAW_LUA_MODULE_AUDIO=y
# CONFIG_ESP_BOARD_PERIPH_I2S_SUPPORT=y
# CONFIG_ESP_BOARD_DEV_AUDIO_CODEC_SUPPORT=y
# CONFIG_ESP_CODEC_DEV_ES8311_USE_DEFAULT_CALIB_IN_FLASH=y

# NAND LittleFS is mounted through the spi_nand_flash block-device layers.
CONFIG_NAND_FLASH_ENABLE_BDL=y

# ESP-Iris owns HS USB: CDC0 carries console/control, CDC1 the data link.
CONFIG_TINYUSB_CDC_ENABLED=y
CONFIG_TINYUSB_CDC_COUNT=2
CONFIG_TINYUSB_CDC_RX_BUFSIZE=1024
CONFIG_TINYUSB_CDC_TX_BUFSIZE=1024
CONFIG_TINYUSB_CDC_EP_BUFSIZE=512
CONFIG_ESP_IRIS_FIRMWARE_ROLE=1
CONFIG_ESP_IRIS_PRODUCT_CONTRACT="esp-mosaico/v2"
CONFIG_ESP_IRIS_BOARD_ID="esp-mosaico"
CONFIG_ESP_IRIS_LAYOUT_ID="mosaico-retained-test-2m-v2"
CONFIG_ESP_IRIS_RECOVERY_ABI=2
CONFIG_ESP_IRIS_OTA_DEFAULT_VIA_RECOVERY=y
CONFIG_ESP_IRIS_SYSTEM_INVENTORY=y
# CONFIG_ESP_IRIS_OTA is not set
CONFIG_ESP_IRIS_TRANSPORT_USB=y
# CONFIG_ESP_IRIS_TRANSPORT_TCP is not set
# Share crash-loop state with Vibe Mode.
CONFIG_ESP_IRIS_NVS_PARTITION_NAME="sysmeta"
CONFIG_ESP_IRIS_USB_PRODUCT="ESP-Iris Mosaico Claw"
CONFIG_ESP_IRIS_USB_CONSOLE_HOST_WAIT_MS=0
# Claw accepts an installed image at its own startup boundary.
# CONFIG_ESP_MOSAICO_APP_AUTO_ACCEPT is not set
CONFIG_ESP_IRIS_WIRE_BUFFERS_PSRAM=y
CONFIG_ESP_IRIS_SERVICE_CONTEXT_PSRAM=y
CONFIG_ESP_IRIS_SERVICE_STATE_PSRAM=y
CONFIG_ESP_IRIS_RPC_RESPONSE_PSRAM=y
CONFIG_ESP_IRIS_LOG_RING_STORAGE_PSRAM=y

# Route the interactive ESP console through the native USB Serial/JTAG port.
# CONFIG_ESP_CONSOLE_USB_SERIAL_JTAG=y
# CONFIG_ESP_CONSOLE_USB_SERIAL_JTAG_ENABLED=y
# CONFIG_ESP_CONSOLE_SECONDARY_NONE=y
# CONFIG_ESP_CONSOLE_UART_NUM=-1

CONFIG_ESP_BOARD_DEV_CAMERA_SUPPORT=y
CONFIG_LUA_MODULE_CAMERA_BUFFER_COUNT=1
CONFIG_APP_CLAW_LUA_MODULE_CAMERA=y
CONFIG_LUA_MODULE_VISION_COLOR_DETECT=y
CONFIG_LUA_MODULE_VISION_QRCODE_DETECT=y
CONFIG_ESP_VIDEO_ENABLE_DVP_VIDEO_DEVICE=y
CONFIG_ESP_VIDEO_ENABLE_MIPI_CSI_VIDEO_DEVICE=n
CONFIG_ESP_VIDEO_ENABLE_SPI_VIDEO_DEVICE=n
CONFIG_ESP_VIDEO_ENABLE_USB_UVC_VIDEO_DEVICE=n
CONFIG_ESP_VIDEO_ENABLE_JPEG_VIDEO_DEVICE=n
CONFIG_ESP_VIDEO_ENABLE_H264_VIDEO_DEVICE=n
CONFIG_ESP_VIDEO_ENABLE_SWAP_BYTE=n

CONFIG_CAMERA_OV3640=y
CONFIG_CAMERA_OV3640_AUTO_DETECT_DVP_INTERFACE_SENSOR=y
CONFIG_CAMERA_OV3640_DVP_YUV422_UYVY_640X480_30FPS=y
CONFIG_CAMERA_OV3640_DVP_DEFAULT_FMT_YUV422_UYVY_640X480_30FPS=y
CONFIG_LUA_MODULE_CAMERA_ENABLE_VFLIP=n
CONFIG_LUA_MODULE_CAMERA_ENABLE_HMIRROR=n

CONFIG_CAMERA_SC101IOT=y
CONFIG_CAMERA_SC101IOT_AUTO_DETECT_DVP_INTERFACE_SENSOR=y
CONFIG_CAMERA_SC101IOT_DVP_YUV422_640X480_15FPS=y
CONFIG_CAMERA_SC101IOT_DVP_YUV422_1280X720_25FPS=y
CONFIG_CAMERA_SC101IOT_DVP_DEFAULT_FMT_YUV422_1280X720_25FPS=y

# The native 480x480 Mosaic/GSP UI owns the display on esp_mosaico.
CONFIG_APP_CLAW_MOSAIC_GSP_ENABLE=y
CONFIG_BSP_DISPLAY_ENABLE=n
# Keep image decoding on the render task until the async decoder's
# app-switch lifetime synchronization is fixed.
CONFIG_ESP_GSP_ENABLE_ASYNC_DECODE=n
# Temporary device-side voice/UI validation: do not dispatch to Agent.
CONFIG_LV_DEF_REFR_PERIOD=16
CONFIG_DISPLAY_SERVICE_PRESENT_TE_ENABLE=y
CONFIG_DISPLAY_SERVICE_PRESENT_TE_GPIO=43
CONFIG_LUA_MODULE_BOARD_MANAGER_DISPLAY_SHAPE_ROUNDED_RECT=y
CONFIG_LUA_MODULE_BOARD_MANAGER_DISPLAY_CORNER_RADIUS=60

CONFIG_SPI_FLASH_AUTO_SUSPEND=y
# default:
CONFIG_SPI_FLASH_SUSPEND_TSUS_VAL_US=50
# default:
CONFIG_SPI_FLASH_SUSPEND_TRS_VAL_US=50

# Share the board IMU with Lua through Board Manager.
CONFIG_APP_CLAW_LUA_MODULE_IMU=y
CONFIG_LUA_MODULE_IMU_CHIP_BMI270=y
```

## bootloader_components/main/Kconfig
```kconfig
menu "Mosaico factory recovery boot"

    config FACTORY_RECOVERY_BOOT_GPIO
        int "GPIO used to request factory recovery"
        range 0 61 if IDF_TARGET_ESP32S31
        default 7
        help
            Holding the active-low AI button during reset selects the retained
            factory Recovery image for this boot without changing OTA data.

    config FACTORY_RECOVERY_BOOT_DEBOUNCE_MS
        int "Low-level debounce time (milliseconds)"
        range 0 1000
        default 50
        help
            The input must remain low for this duration before Recovery is
            selected. A released button adds no delay to normal startup.

endmenu
```

## components/asr_service/test_apps/asr_stream/main/Kconfig.projbuild
```kconfig
menu "ASR Service Test Configuration"

    config ASR_TEST_QWEN_API_KEY
        string "Qwen ASR API key"
        default ""
        help
            API key used by the Qwen ASR PCM smoke test. Leave empty to skip the Qwen stream test.

    config ASR_TEST_PCM_CHUNK_DELAY_MS
        int "PCM chunk send interval in ms"
        range 0 100
        default 20
        help
            Delay after each 20 ms PCM frame is sent. Keep the default for realtime-like streaming.

endmenu
```

## components/display_service/Kconfig
```kconfig
menu "Display service"

config DISPLAY_SERVICE_PRESENT_TE_ENABLE
    bool "Enable presenter TE synchronization"
    default y
    help
        Enable GPIO tearing-effect synchronization for panel-IO displays.
        The panel initialization sequence must also enable its TE output.

if DISPLAY_SERVICE_PRESENT_TE_ENABLE

config DISPLAY_SERVICE_PRESENT_TE_GPIO
    int "TE GPIO"
    range 0 63
    default 43

config DISPLAY_SERVICE_PRESENT_TE_BUS_FREQ_HZ
    int "Panel bus clock (Hz)"
    range 1 120000000
    default 40000000
    help
        Used to estimate whether a transfer fits in the current TE window.

config DISPLAY_SERVICE_PRESENT_TE_DATA_LINES
    int "Panel bus data lines"
    range 1 8
    default 4

config DISPLAY_SERVICE_PRESENT_TE_REFRESH_WINDOW_PERCENT
    int "Usable TE refresh window percent"
    range 1 100
    default 80

endif

endmenu
```

## components/mosaic_ui/Kconfig
```kconfig
menu "Mosaic UI (esp-gsp)"

    config MOSAIC_UI_DISABLE_BUNDLE_CRC
        bool "Skip runtime CRC scan for built-in Mosaic bundles"
        default y
        help
            Skip the whole-bundle CRC scan each time Hub or an App runtime is
            created. Header, alignment, member bounds and nested resource
            validation remain enabled. The ui_assets partition contains trusted
            build-time assets and is validated by its asset container.

    config MOSAIC_UI_AI_CREATE_DEVICE_MOCK
        bool "Use local AI Create response backend"
        depends on APP_CLAW_MOSAIC_GSP_ENABLE
        default n
        help
            Keep the real device microphone and ASR path, but replace the AI
            Create Agent gateway with deterministic local response events.
            This is intended for device-side voice and navigation validation;
            disable it before testing Agent integration.

    config MOSAIC_UI_BLUETOOTH_AUDIO
        bool "Classic Bluetooth A2DP speaker App"
        depends on APP_CLAW_MOSAIC_GSP_ENABLE && BT_CLASSIC_ENABLED && BT_BLUEDROID_ENABLED
        depends on BT_A2DP_ENABLE && BT_A2DP_USE_EXTERNAL_CODEC && BT_AVRCP_ENABLED
        default y
        help
            Add the GSP Bluetooth media App. Opening the App initializes the
            Classic Bluetooth A2DP Sink and AVRCP profiles; leaving the App
            disconnects peers and fully disables the Bluetooth controller.

endmenu
```

## components/mosaico_camera_service/Kconfig.projbuild
```kconfig
menu "Mosaico Camera Service"

    config MOSAICO_CAMERA_EQUIVALENT_ROI
        bool "Use the equivalent SC101IOT preview window"
        depends on CAMERA_SC101IOT
        default y
        help
            Configure the current 1280x720 UYVY sensor mode to output only
            the 768x720 window consumed by Mosaic preview and photographs.
            Keeps the mode's clock, frame rate and image-processing registers.
            Other sensors and unrecognized modes retain their native format.
            Requires the GSP public Session trim and ownership-result APIs;
            the product checks this during configuration. GSP 1.9.0 provides
            the required public APIs.

endmenu
```

## components/trial_provider/Kconfig
```kconfig
menu "Trial Provider"

config TRIAL_DEVICE_HMAC_KEY_ID
    int "eFuse HMAC key block"
    range 0 5
    default 0
    help
        eFuse HMAC key block used to sign Trial provider challenges.
        Board-specific configuration should override this value to match
        the production provisioning layout.

endmenu
```

## components/weather_service/Kconfig
```kconfig
menu "Weather service"
    config WEATHER_CITY_SEARCH_URL
        string "City search API URL prefix"
        default "https://geocoding-api.open-meteo.com/v1/search?count=6&language=en&format=json&name="
        help
            Explicit city searches append a percent-encoded query. The endpoint
            must return the Open-Meteo geocoding JSON schema. Production products
            can use a licensed endpoint or a compatible backend proxy. Location
            data attribution: GeoNames / Open-Meteo.
endmenu
```

## main/Kconfig.projbuild
```kconfig
menu "App Config"

    config APP_CLAW_MOSAIC_GSP_ENABLE
        bool "esp-gsp Mosaic UI"
        depends on ESP_BOARD_DEV_DISPLAY_LCD_SUPPORT
        depends on APP_CLAW_CAP_CORE
        depends on APP_CLAW_CAP_SKILL_MGR
        depends on APP_CLAW_CAP_IM_WECHAT
        select MOSAIC_UI_ENABLE
        default n
        help
            Enable the product-owned esp-gsp Mosaic UI instead of ESP-Claw's
            generic LVGL system UI. Board defaults must disable
            APP_CLAW_SYSTEM_UI_ENABLE when this option is selected.

menu "ESP-Mosaico battery gauge"
    depends on ESP_BOARD_ESP_MOSAICO

    config MOSAICO_BATTERY_OVERRIDE_CHARGE_TERMINATION
        bool "Apply characterized BQ27220 charge termination parameters"
        default n
        help
            Enable only after the cell maximum charge voltage and the charger
            termination current have been confirmed. The nominal 3.7 V / 65 mAh
            rating alone does not determine these parameters. Disabled builds
            retain the gauge's existing charge termination configuration.

    config MOSAICO_BATTERY_CHARGING_VOLTAGE_MV
        int "BQ27220 Charging Voltage (mV)"
        range 2500 4600
        default 4200
        depends on MOSAICO_BATTERY_OVERRIDE_CHARGE_TERMINATION

    config MOSAICO_BATTERY_TAPER_CURRENT_MA
        int "BQ27220 Taper Current (mA)"
        range 1 1000
        default 100
        depends on MOSAICO_BATTERY_OVERRIDE_CHARGE_TERMINATION
        help
            Gauge termination detection only; this does not set charger current.
            The default is TI's reference value, not a characterized value for
            the Mosaico cell. Match this to the cell and charger. Valid charge
            termination also requires two 40 s windows with over 0.25 mAh in
            each window, and voltage above Charging Voltage minus Taper Voltage.

    config MOSAICO_BATTERY_TAPER_VOLTAGE_MV
        int "BQ27220 Taper Voltage margin (mV)"
        range 0 1000
        default 100
        depends on MOSAICO_BATTERY_OVERRIDE_CHARGE_TERMINATION
        help
            Voltage margin below Charging Voltage, not an absolute cell voltage.
            This applies to the board's existing RAM CEDV profile 1.
endmenu

menu "Default Wi-Fi Settings"

    config APP_WIFI_SSID
        string "Default Wi-Fi SSID"
        default ""
        help
            Default Wi-Fi SSID used to populate app settings.

    config APP_WIFI_PASSWORD
        string "Default Wi-Fi password"
        default ""
        help
            Default Wi-Fi password used to populate app settings.

    config APP_WIFI_AP_SSID_PREFIX
        string "Provisioning AP SSID prefix"
        default "esp-claw"
        help
            Prefix used to build the unique provisioning AP SSID. The full
            SSID is "<prefix>-<MAC[3..5]>" (e.g. esp-claw-84AEE5).

    config APP_WIFI_AP_CHANNEL
        int "Provisioning AP channel"
        range 1 13
        default 1
        help
            Channel used by the provisioning SoftAP.

    config APP_WIFI_AP_MAX_CONN
        int "Provisioning AP max connections"
        range 1 10
        default 4
        help
            Maximum number of concurrent stations on the provisioning AP.

    config APP_WIFI_MAX_RETRY
        int "STA max retries before AP fallback"
        range 1 20
        default 5
        help
            After this many consecutive STA connection failures the device
            falls back to pure AP mode and waits for the user to provision
            new credentials.

endmenu

menu "Default Search Settings"

    config APP_SEARCH_HTTP_ALLOWLIST
        string "Default HTTP Request allowlist"
        default "*"
        help
            Default value used to populate app setting `search_http_allowlist`.
            Use `*` to allow all hosts, or a comma-separated list of domains/IPs.

            e.g. "api.example.com,*.example.org,203.0.113.10"

endmenu

endmenu
```

## tools/mosaico_recovery/sdkconfig.defaults
```kconfig
CONFIG_IDF_TARGET="esp32s31"
CONFIG_IDF_EXPERIMENTAL_FEATURES=y
CONFIG_ESPTOOLPY_FLASHSIZE_16MB=y
CONFIG_PARTITION_TABLE_CUSTOM=y
CONFIG_PARTITION_TABLE_CUSTOM_FILENAME="../../partitions_16MB.csv"
```
